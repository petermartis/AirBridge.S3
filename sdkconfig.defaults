## sdkconfig.defaults
```kconfig
# AirBridge.S3 — sdkconfig defaults
# Used by PlatformIO ESP-IDF hybrid build (pioarduino)

# --- Arduino-as-component ---
CONFIG_AUTOSTART_ARDUINO=y
CONFIG_FREERTOS_HZ=1000

# --- IPv4 routing / NAT (NAPT) ---
CONFIG_LWIP_IP_FORWARD=y
CONFIG_LWIP_IPV4_NAPT=y

# --- TinyUSB ECM networking (ECM preferred over NCM for macOS compatibility) ---
CONFIG_TINYUSB_NET_MODE_ECM_RNDIS=y

# --- Use custom PID to avoid macOS driver cache from NCM device ---
CONFIG_TINYUSB_DESC_USE_DEFAULT_PID=n
CONFIG_TINYUSB_DESC_CUSTOM_PID=0x4002

# --- DMA mode: needed for interrupt EP notification delivery ---
CONFIG_TINYUSB_MODE_DMA=y
# CONFIG_TINYUSB_MODE_SLAVE is not set

CONFIG_ESP_DEFAULT_CPU_FREQ_MHZ_240=y

# --- FreeRTOS runtime stats (for CPU utilization monitoring) ---
CONFIG_FREERTOS_GENERATE_RUN_TIME_STATS=y
CONFIG_FREERTOS_USE_TRACE_FACILITY=y

# --- Disable HTTPS server (we only use HTTP) ---
CONFIG_ESP_HTTPS_SERVER_ENABLE=n

# --- USB OTG mode for TinyUSB (no serial console — use LCD for debug) ---
CONFIG_ARDUINO_USB_CDC_ON_BOOT=0
CONFIG_ARDUINO_USB_MODE=0

# --- Disable USB-Serial/JTAG console: it shares GPIO19/20 with USB OTG ---
CONFIG_ESP_CONSOLE_SECONDARY_NONE=y

# --- Flash size ---
CONFIG_ESPTOOLPY_FLASHSIZE_16MB=y
```
